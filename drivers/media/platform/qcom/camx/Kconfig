## drivers/media/platform/qcom/camx/Kconfig
```kconfig
# SPDX-License-Identifier: GPL-2.0-only
config SPECTRA_CAMERA
	tristate "Qualcomm Spectra Camera (CamX camera_kt) driver"
	depends on ARCH_QCOM && MEDIA_SUPPORT && VIDEO_DEV && MEDIA_CONTROLLER && VIDEO_V4L2_SUBDEV_API
	select SPECTRA_KT
	select SPECTRA_ISP
	select SPECTRA_ICP
	select SPECTRA_JPEG
	select SPECTRA_LRME
	select SPECTRA_SENSOR
	select SPECTRA_SENSOR_SYSFS_UTIL
	select ENABLE_US_API
	help
	  Qualcomm Spectra Camera (CamX camera_kt) subsystem driver from
	  qualcomm-linux/camera-driver, integrated in-tree for SM7125 (atoll)
	  on Linux 7.3.

config SPECTRA_KT
	bool

config SPECTRA_ISP
	bool

config SPECTRA_ICP
	bool

config SPECTRA_JPEG
	bool

config SPECTRA_LRME
	bool

config SPECTRA_SENSOR
	bool

config SPECTRA_SENSOR_SYSFS_UTIL
	bool

config ENABLE_US_API
	bool
```

## drivers/net/wireless/cnss_platform/Kconfig
```kconfig
# SPDX-License-Identifier: GPL-2.0-only

menu "Qualcomm CNSS / ICNSS WLAN Platform"

config CNSS_UTILS
	tristate "CNSS utilities support"
	help
	  Add CNSS utilities support for the WLAN driver module.

config CNSS_QMI_SVC
	tristate "CNSS QMI SVC support"
	depends on QCOM_QMI_HELPERS
	help
	  Add CNSS QMI service definitions for WLAN firmware QMI communication.

config CNSS_GENL
	tristate "CNSS Generic Netlink Socket Driver"
	help
	  Generic netlink family "CLD80211" for QCACLD userspace communication.

config WCNSS_MEM_PRE_ALLOC
	tristate "WCNSS pre-alloc memory support"
	help
	  Pre-allocate memory pools for the QCACLD WLAN driver.

config ICNSS2
	tristate "Platform driver for Q6 integrated WLAN (ICNSS2)"
	depends on QCOM_QMI_HELPERS && QCOM_PDR_HELPERS
	select CNSS_UTILS
	help
	  Platform driver for Qualcomm Q6 integrated WLAN connectivity
	  subsystem (WCN3990/ADRASTEA and WCN6750/WCN6450/WCN7750).

config ICNSS2_DEBUG
	bool "ICNSS2 Platform Driver Debug Support"
	depends on ICNSS2

config ICNSS2_QMI
	bool "ICNSS2 Platform Driver QMI support"
	depends on ICNSS2
	select CNSS_QMI_SVC

config CNSS_QCA6750
	bool "Enable ICNSS QCA6750 chipset specific changes"
	depends on ICNSS2

endmenu
```
